#include "GPIO.h"

/**********************************************************************************************************
*	函 数 名：Delay_50ns
*	功能说明：短延时，用于模拟时序通信
*	形    参：
*	返 回 值：
**********************************************************************************************************/
void Delay_50ns(uint16_t ns)  //20210627用示波器测量，Delay_50ns(10)延时640ns
{
	uint16_t i;
	for(i=0;i<ns;i++);
}

/**********************************************************************************************************
*	函 数 名：Delay_us
*	功能说明：1us延时
*	形    参：
*	返 回 值：
**********************************************************************************************************/
void Delay_us(uint16_t us)  //20210627用示波器测量，Delay_us(10)延时10us
{
	uint16_t i,j;
	for(i=0;i<us;i++)
		for(j=0;j<20;j++);
}

/**********************************************************************************************************
*	函 数 名：Delay_ms
*	功能说明：1ms延时
*	形    参：
*	返 回 值：
**********************************************************************************************************/
void delay_1ms(uint16_t ms)  //20210627用示波器测量，delay_1ms(1)延时1ms
{
	uint16_t i,j;
	for(i=0;i<ms;i++)
		for(j=0;j<19000;j++);
}

/**********************************************************************************************************
*	函 数 名：mGPIO_Init
*	功能说明：GPIO初始化
*	形    参：
*	返 回 值：
**********************************************************************************************************/ 
void mGPIO_Init(void)
{
	//时钟使能
    rcu_periph_clock_enable(RCU_AF);
	rcu_periph_clock_enable(RCU_GPIOA);
	rcu_periph_clock_enable(RCU_GPIOB);
	rcu_periph_clock_enable(RCU_GPIOC);
	//重映射
	gpio_pin_remap_config(GPIO_SWJ_SWDPENABLE_REMAP, ENABLE);
	
	//初始化
    gpio_init(USB_PULLUP_PORT, GPIO_MODE_OUT_PP, GPIO_OSPEED_50MHZ, USB_PULLUP_PIN);   
	gpio_init(CRG_STA_PORT, GPIO_MODE_IPU, GPIO_OSPEED_50MHZ, CRG_STA_PIN);
	
}

/**********************************************************************************************************
*	函 数 名：gd_eval_led_toggle
*	功能说明：运行灯闪烁
*	形    参：
*	返 回 值：
**********************************************************************************************************/ 
void gd_eval_led_toggle(void)
{
    gpio_bit_write(GPIOA, GPIO_PIN_15, (bit_status)(1-gpio_input_bit_get(GPIOA, GPIO_PIN_15)));
}



